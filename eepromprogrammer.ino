// set pin variables
const byte DATA_PINS[8] = { 5, 6, 7, 8, 9, 10, 11, 12 };
const byte SER_PIN = 2;
const byte LATCH_PIN = 3;
const byte CLOCK_PIN = 4;
const byte WRITE_PIN = A0;   // active low
const byte OUTPUT_PIN = A1;  // active low
const byte LED_PIN = A2;     // indicator light

// alias for dumping binary into clipboard to paste here:
// hexasm a.out | xclip -selection clipboard
// ctrl + shift + k to delete previous line

byte instructions[] = {
  0x4c,0x76,0x80,0x48,0xda,0xa5,0x02,0x29,0x01,0xf0,0x23,0xa5,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0x3f
  
};

void setAddress(word address /* 0x0000 - 0x7FFF) */) {
  // shifts out to two 595 shift registers
  digitalWrite(LATCH_PIN, LOW);
  shiftOut(SER_PIN, CLOCK_PIN, LSBFIRST, lowByte(address));
  shiftOut(SER_PIN, CLOCK_PIN, LSBFIRST, highByte(address));
  digitalWrite(LATCH_PIN, HIGH);
}

byte readByte() {
  byte output = 0;
  // data pins not set to input because they are set to input by default
  // do not write to eeprom in the same program as reading, causes hardware issues
  for (int i = 0; i < 8; i++) {
    bitWrite(output, i, digitalRead(DATA_PINS[i]));
  }
  return output;
}
void printByte() {
  char buf[16];
  sprintf(buf, "%02X ", readByte());
  Serial.print(buf);
}
void printEEPROM() {
  digitalWrite(OUTPUT_PIN, LOW);
  for (int i = 0; i < 0x800; i++) {
    char addrBuf[16];
    sprintf(addrBuf, "%04X: ", i * 0x10);
    Serial.print(addrBuf);
    for (int j = 0; j < 0x10; j++) {
      // char dataBuf[8];
      setAddress(j + (i * 0x10));
      // sprintf(dataBuf, "%02X ", readByte());
      // Serial.print(dataBuf);
      printByte();
    }
    Serial.println();
  }
}

void writeByte(byte data) {
  digitalWrite(OUTPUT_PIN, HIGH);
  for (int i = 0; i < 8; i++) {
    pinMode(DATA_PINS[i], OUTPUT);
    digitalWrite(DATA_PINS[i], bitRead(data, i));
  }
  digitalWrite(WRITE_PIN, LOW);
  delayMicroseconds(1);
  digitalWrite(WRITE_PIN, HIGH);
  delay(10);
}
void clearEEPROM(byte clearByte) {
  // takes like 5 minutes, be patient with this one
  for (unsigned int i = 0; i < 0x8000; i++) {
    setAddress(i);
    writeByte(clearByte);
  }
}
void writeOrigin(word originData) {
  // sets the starting address of the program counter, 6502 specific
  setAddress(0x7FFC);
  writeByte(lowByte(originData));
  setAddress(0x7FFD);
  writeByte(highByte(originData));
}
word readOrigin() {
  word output = 0x0000;
  setAddress(0x7FFD);
  output = readByte() * 0x100;  // shifts read byte to upper half of word
  setAddress(0x7FFC);
  output += readByte();
  return output;
}

void writeInstructions(word startingAddress) {
  for (int i = 0; i < sizeof(instructions) / sizeof(instructions[0]); i++) {
    setAddress(startingAddress + i);
    writeByte(instructions[i]);
  }
}

void setup() {
  // put your setup code here, to run once:
  /* serial and pin setups */
  for (int i = 0; i < 8; i++) {
    pinMode(DATA_PINS[i], INPUT);
  }

  pinMode(SER_PIN, OUTPUT);
  pinMode(LATCH_PIN, OUTPUT);
  pinMode(CLOCK_PIN, OUTPUT);

  digitalWrite(WRITE_PIN, HIGH);
  pinMode(WRITE_PIN, OUTPUT);
  digitalWrite(WRITE_PIN, HIGH);

  pinMode(OUTPUT_PIN, OUTPUT);
  digitalWrite(OUTPUT_PIN, HIGH);

  pinMode(LED_PIN, OUTPUT);

  Serial.begin(9600);

  /* sent out instructions */
  digitalWrite(LED_PIN, HIGH);
  Serial.println("start");


  digitalWrite(OUTPUT_PIN, LOW);
  printEEPROM();

  // char buf[16];
  // sprintf(buf, "%02X ", readOrigin());
  // Serial.print(buf);
  // word interruptVec = 0x8003;

  // writeInstructions(0x0000);

  // setAddress(0x7FFE);
  // writeByte(lowByte(interruptVec));
  // setAddress(0x7FFF);
  // writeByte(highByte(interruptVec));
  // writeOrigin(0x8000);
  Serial.println("end");
}

void loop() {
  // put your main code here, to run repeatedly:
  digitalWrite(LED_PIN, HIGH);
  delay(300);
  digitalWrite(LED_PIN, LOW);
  delay(300);
}
